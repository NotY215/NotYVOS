## os/configs/notyvos_x86_64_defconfig
```kconfig
BR2_x86_64=y
BR2_TOOLCHAIN_BUILDROOT_CXX=y
BR2_TARGET_GENERIC_HOSTNAME="notyvos"
BR2_TARGET_GENERIC_ISSUE="NotYVOS"
BR2_INIT_BUSYBOX=y
BR2_ROOTFS_DEVICE_CREATION_DYNAMIC_EUDEV=y
BR2_ROOTFS_OVERLAY="$(BR2_EXTERNAL_NOTYVOS_PATH)/board/notyvos/overlay"
BR2_ROOTFS_POST_BUILD_SCRIPT="$(BR2_EXTERNAL_NOTYVOS_PATH)/board/notyvos/post-build.sh"
BR2_GLOBAL_PATCH_DIR="$(BR2_EXTERNAL_NOTYVOS_PATH)/board/notyvos/patches"
BR2_LINUX_KERNEL=y
BR2_LINUX_KERNEL_USE_ARCH_DEFAULT_CONFIG=y
BR2_LINUX_KERNEL_CONFIG_FRAGMENT_FILES="$(BR2_EXTERNAL_NOTYVOS_PATH)/board/notyvos/linux.fragment"
BR2_LINUX_KERNEL_INSTALL_TARGET=y
BR2_PACKAGE_MESA3D=y
BR2_PACKAGE_MESA3D_GALLIUM_DRIVER_SOFTPIPE=y
BR2_PACKAGE_MESA3D_GALLIUM_DRIVER_VIRGL=y
BR2_PACKAGE_MESA3D_OPENGL_EGL=y
BR2_PACKAGE_MESA3D_OPENGL_ES=y
BR2_PACKAGE_LIBINPUT=y
BR2_PACKAGE_SEATD=y
BR2_PACKAGE_WAYLAND=y
BR2_PACKAGE_WLROOTS=y
BR2_PACKAGE_CAGE=y
BR2_PACKAGE_XKEYBOARD_CONFIG=y
BR2_PACKAGE_SDL2=y
BR2_PACKAGE_SDL2_WAYLAND=y
BR2_PACKAGE_SDL2_TTF=y
BR2_PACKAGE_SDL2_IMAGE=y
BR2_PACKAGE_LINUX_FIRMWARE=y
BR2_PACKAGE_NOTYVOS_XMB=y
BR2_TARGET_ROOTFS_EXT2=y
BR2_TARGET_ROOTFS_EXT2_4=y
BR2_TARGET_ROOTFS_EXT2_SIZE="768M"
```

## os/package/notyvos-xmb/Config.in
```kconfig
config BR2_PACKAGE_NOTYVOS_XMB
	bool "notyvos-xmb"
	depends on BR2_INSTALL_LIBSTDCPP
	help
	  The NotYVOS XMB user interface (SDL2).
```
